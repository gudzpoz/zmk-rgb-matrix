## Kconfig
```kconfig
config LED_STRIP_COMPOSITE
    bool "Composite RGB LED strip"
    default y
    depends on DT_HAS_ZMK_LED_STRIP_COMPOSITE_ENABLED
    select LED_STRIP
    help
      Concatenates the devices referenced by a zmk,led-strip-composite node
      into one RGB LED strip. Available independently of the RGB matrix.

config LED_STRIP_COMPOSITE_INIT_PRIORITY
    int "Composite LED strip initialization priority"
    default 91
    range 0 99
    depends on LED_STRIP_COMPOSITE
    help
      POST_KERNEL-level initialization priority. Child devices must initialize
      earlier and consumers later. Nested composites at the same priority are
      ordered by devicetree dependencies on Zephyr 4.1.

config KEYPAW_RGB_MATRIX
    bool "Keypaw position-aware RGB matrix"
    default y
    depends on DT_HAS_KEYPAW_RGB_MATRIX_ENABLED
    select LED_STRIP
    help
      Drives an RGB LED strip with per-key, position-aware effects. The LED
      geometry (leds/mapping) comes from the keypaw,rgb-matrix devicetree
      node and the strip itself from its "strip" phandle.

if KEYPAW_RGB_MATRIX

config KEYPAW_RGB_WORKQUEUE_STACK_SIZE
    int "RGB matrix work queue stack size"
    default 2048
    range 1024 8192
    help
      Stack for the module's dedicated low-priority work queue, which runs all
      engine work: render passes, condition and trigger evaluation, split sync
      and the settings reset. Size it for the deepest chain, not just rendering:
      a fired trigger invokes a selector control, which on the split central
      reaches the BLE transport. Keep it above the observed high-water mark with
      margin.

config KEYPAW_RGB_WORKQUEUE_PRIORITY
    int "RGB matrix work queue thread priority"
    default 10
    help
      Priority of the module's work queue thread. The default matches ZMK's
      low-priority work queue so RGB work never preempts typing.

config KEYPAW_RGB_MATRIX_TICK_MS
    int "Animation tick period (ms)"
    default 32
    range 1 1000
    help
      Upstream underglow uses 50 ms; 32 ms is noticeably smoother for the
      reactive and ripple effects. One update costs ~1.5 ms of blocking SPI.

config KEYPAW_RGB_MATRIX_HUE_STEP
    int "Hue adjustment step"
    default 10

config KEYPAW_RGB_MATRIX_SAT_STEP
    int "Saturation adjustment step"
    default 10

config KEYPAW_RGB_MATRIX_BRT_STEP
    int "Brightness adjustment step"
    default 10

config KEYPAW_RGB_MATRIX_DURATION_STEP
    int "Duration adjustment step (ms)"
    default 100
    help
      Animation "speed" is expressed as a period: a shorter duration animates
      faster. This is added to (or subtracted from) the active effect's period
      by the Duration Up/Down commands. An additive step is used because the
      relative press is resolved to an absolute value on the split central, and
      adding is exact regardless of the current period.

config KEYPAW_RGB_MATRIX_DURATION_MIN_MS
    int "Fastest animation period (ms)"
    default 100
    range 1 60000

config KEYPAW_RGB_MATRIX_DURATION_MAX_MS
    int "Slowest animation period (ms)"
    default 10000
    range 1 60000

# Caps Lock will pull in a HID-indicator event dependency. Disable it if you
# don't need that.
config KEYPAW_RGB_CONDITION_CAPS_LOCK
    bool
    default y
    depends on DT_HAS_KEYPAW_RGB_CONDITION_CAPS_LOCK_ENABLED
    select ZMK_HID_INDICATORS
    help
      Caps Lock condition. Enabled by the presence of a
      keypaw,rgb-condition-caps-lock node. Selects ZMK_HID_INDICATORS, which is
      what the host sets when Caps Lock is on.

# BLE host-profile state exists only on the central, so the condition reads it
# there and returns false on a peripheral.
config KEYPAW_RGB_CONDITION_BLE
    bool
    default y
    depends on DT_HAS_KEYPAW_RGB_CONDITION_BLE_ENABLED
    help
      Bluetooth profile condition. Enabled by the presence of a
      keypaw,rgb-condition-ble node. Matches the active profile index and
      connection state; a build without Bluetooth compiles the condition to a
      constant false.

endif # KEYPAW_RGB_MATRIX

config KEYPAW_RGB_TRIGGERS
    bool "RGB matrix trigger table"
    default y
    depends on KEYPAW_RGB_MATRIX
    depends on DT_HAS_KEYPAW_RGB_TRIGGER_TABLE_ENABLED
    depends on !ZMK_SPLIT || ZMK_SPLIT_ROLE_CENTRAL
    help
      Edge-triggered condition -> RGB command rules, declared as the children of
      a keypaw,rgb-trigger-table node (their declaration order is the firing
      order). Each rule runs its `on-enter` when its condition becomes active and
      its `on-exit` when it clears; rules are independent, so none shadows
      another. Each trigger references a reusable keypaw,rgb-condition-* node.

      Built for the split central only: a trigger's condition may read keymap
      state, which does not exist on a peripheral. The commands still reach both
      halves because the behavior is BEHAVIOR_LOCALITY_GLOBAL.

config KEYPAW_RGB_SPLIT_SYNC
    bool "Push the RGB state to a split peripheral when it connects"
    default y
    depends on KEYPAW_RGB_MATRIX
    depends on ZMK_SPLIT && ZMK_SPLIT_ROLE_CENTRAL
    help
      Reconnect and transport changes replay global user power, brightness,
      synchronized overlay gates and every controlled composition's member
      colors, periods and selection, including inactive members. Overlapping
      converted invocations and failed converted callbacks request repair when
      their invocation group finishes. Ordinary isolated successful commands,
      direct callbacks and local APIs do not request repair.

      Each attempt samples current state. Replay repeats until generation is
      unchanged and no converted invocation remains outstanding. Successful
      state sends are paced 50 ms apart; observed failures retry that peripheral
      after 1 second without blocking other peripherals or clock correction.

      Built for the split central only; control remains live while output is
      off, inhibited, hidden or has no local LEDs. Both halves must use matching
      canonical behavior names and member slots. Transport success means local
      acceptance, not acknowledged delivery or an atomic scene transaction.
      The keypaw,rgb-matrix node is the global endpoint on both halves for
      power, brightness, overlay gates and shared-clock commands, even when
      no selectors are configured.

if KEYPAW_RGB_SPLIT_SYNC

config KEYPAW_RGB_SPLIT_SYNC_POLL_MS
    int "Peripheral connection poll period (ms)"
    default 1000
    range 1 60000
    help
      How often the connected-source set is sampled without radio traffic.
      Disconnects shorter than this period may be missed. Observed reconnects
      and transport changes request full replay after the settle delay.

config KEYPAW_RGB_SPLIT_SYNC_SETTLE_MS
    int "Delay before pushing to a newly connected peripheral (ms)"
    default 1000
    range 1 60000
    help
      A peripheral is marked connected before its GATT characteristics have been
      discovered, and the split worker drops a command sent in that window with
      "Run behavior handle not found" without reporting it back to the sender.
      Waiting this long after the connection is seen gives discovery and the
      security upgrade time to finish. Best effort, not a guarantee.

config KEYPAW_RGB_SPLIT_SYNC_CLOCK_MS
    int "Shared animation clock re-sync period (ms)"
    default 30000
    range 1000 60000
    help
      How often the central re-sends its monotonic uptime so a peripheral
      corrects crystal drift in its shared animation-clock offset. Runs
      independently of the connection poll; an early drop self-heals on the
      next period.

endif # KEYPAW_RGB_SPLIT_SYNC
```

## dts/bindings/behaviors/keypaw,behavior-rgb-matrix.yaml
```yaml
# Copyright (c) 2026 The ZMK Contributors
# SPDX-License-Identifier: MIT

description: Global RGB matrix control facade (single instance)

compatible: "keypaw,behavior-rgb-matrix"

include: two_param.yaml

properties:
  selector:
    type: phandle
    description: |
      Explicit selector alias for selection, hue/saturation and duration commands.
      Must reference an enabled keypaw,rgb-overlay-selector with a canonical
      keypaw,behavior-rgb-selector control. Power, brightness and reset stay global.
```

## dts/bindings/behaviors/keypaw,behavior-rgb-overlay-toggle.yaml
```yaml
# Copyright (c) 2026 The ZMK Contributors
# SPDX-License-Identifier: MIT

description: |
  Zero-parameter toggle for the latch condition it is nested under.

  Declare one as the single child of a keypaw,rgb-condition-latch and bind it in
  the keymap. Pressing it sets that latch to the absolute value resolved on the
  split central, then repaints, so the overlay gated by the latch appears or
  disappears.

  It is BEHAVIOR_LOCALITY_GLOBAL on purpose: the absolute state reaches both
  halves, so a `local;` overlay that evaluates its own latch still lights up on
  a keypress, and a peripheral that rebooted converges on the next press.

  The node name must be <= 8 characters: the split link serialises the behavior
  name into a 9-byte field (ZMK_SPLIT_RUN_BEHAVIOR_DEV_LEN). A longer name is a
  build error.

compatible: "keypaw,behavior-rgb-overlay-toggle"

include: [zero_param.yaml]
```

## dts/bindings/behaviors/keypaw,behavior-rgb-selector.yaml
```yaml
# Copyright (c) 2026 The ZMK Contributors
# SPDX-License-Identifier: MIT

description: Addressed RGB effect-selector control

compatible: "keypaw,behavior-rgb-selector"

include: two_param.yaml

properties:
  selector:
    type: phandle
    required: true
    description: |
      Enabled keypaw,rgb-overlay-selector controlled by this behavior. Each
      selector must have exactly one enabled control. The behavior's device
      name must fit eight characters; the selector's name has no such limit.
      Accepts RGB effect, hue/saturation, duration and RGB_RESET commands.
      RGB_RESET restores only this selector's defaults. Power and master
      brightness commands belong to keypaw,behavior-rgb-matrix.
```

## dts/bindings/keypaw,rgb-condition-always.yaml
```yaml
# Copyright (c) 2026 The ZMK Contributors
# SPDX-License-Identifier: MIT

description: |
  Unconditionally active. With startup="enter-if-active" (the default), a trigger
  using it fires on-enter once after defaults, settings and provider readiness.
  With startup="baseline", no startup action runs. It never falls, so on-exit
  never runs. An overlay gated by it is always eligible to paint.

compatible: "keypaw,rgb-condition-always"
```

## dts/bindings/keypaw,rgb-condition-and.yaml
```yaml
# Copyright (c) 2026 The ZMK Contributors
# SPDX-License-Identifier: MIT

description: |
  Logical AND over other conditions: active only while every referenced
  condition is active. `conditions` lists the operands; a combinator may itself
  reference other combinators, but the reference graph must be acyclic. An
  omitted `condition` on a consumer means "unconditionally active"; this node is
  how two or more predicates are combined instead.

compatible: "keypaw,rgb-condition-and"

properties:
  conditions:
    type: phandles
    required: true
    description: |
      Conditions to combine, all of which must be active. A devicetree array
      cannot be empty, and an empty list is rejected at build time.
```

## dts/bindings/keypaw,rgb-condition-battery.yaml
```yaml
# Copyright (c) 2026 The ZMK Contributors
# SPDX-License-Identifier: MIT

description: |
  Tests this half's reported battery percentage and/or USB power. A local
  overlay evaluates each half independently; a central-evaluated consumer
  uses the central half's state.

  SOC thresholds require CONFIG_ZMK_BATTERY_REPORTING. The initial ZMK value
  is zero until a successful measurement; this condition uses that value.
  Measurements can remain stale during IDLE/SLEEP. Threshold changes take
  effect when an updated measurement is reported, not immediately when the
  physical charge changes. Power-only predicates do not require reporting.

  Charging/discharging require CONFIG_USB_DEVICE_STACK on each evaluating
  half. They describe USB power presence, not charger telemetry or battery
  current. No reporting or USB subsystem is enabled by this condition.

compatible: "keypaw,rgb-condition-battery"
include: keypaw,rgb-condition-common.yaml

properties:
  below:
    type: int
    default: 101
    description: |
      Require SOC strictly below this value (1..101). The default imposes no
      upper bound. Together with above, the integer interval must be nonempty.

  above:
    type: int
    default: -1
    description: |
      Require SOC strictly above this value (-1..99). The default imposes no
      lower bound. With both default bounds, state must not be any.

  state:
    type: string
    default: "any"
    enum: ["any", "charging", "discharging"]
    description: |
      Any ignores USB power; charging requires VBUS present (including HID
      hosts); discharging requires VBUS absent.
```

## dts/bindings/keypaw,rgb-condition-ble.yaml
```yaml
# Copyright (c) 2026 The ZMK Contributors
# SPDX-License-Identifier: MIT

description: |
  Bluetooth condition: active while the given test of the active BLE profile
  holds. Host profile state exists only where the host link does, which on a
  split is the central half. The condition still compiles and links on a
  peripheral and returns false there, so a shared devicetree expands on both
  halves; a default (central-evaluated) overlay consumes the pushed bit.

compatible: "keypaw,rgb-condition-ble"

properties:
  profile:
    type: int
    required: false
    default: -1
    description: |
      Active BLE profile index to match (0-based), or -1 to match any profile.
      An index at or beyond the built-in profile count never matches.

  state:
    type: string
    required: false
    default: "any"
    enum: ["any", "connected", "disconnected", "open"]
    description: |
      Connection test applied to the active profile. `connected` is a bonded
      profile that is currently linked; `disconnected` is any profile that is
      not linked, bonded or not; `open` is a profile with no stored bond, i.e.
      still pairing. `any` matches regardless of connection state.
```

## dts/bindings/keypaw,rgb-condition-caps-lock.yaml
```yaml
# Copyright (c) 2026 The ZMK Contributors
# SPDX-License-Identifier: MIT

description: |
  Caps Lock condition: active while the host reports the HID Caps Lock LED as
  set. Tracked from zmk_hid_indicators_changed rather than a getter, because a
  split peripheral re-raises that event but has no hid_indicators getter to
  call; the condition therefore works on both halves.

compatible: "keypaw,rgb-condition-caps-lock"
```

## dts/bindings/keypaw,rgb-condition-common.yaml
```yaml
# Copyright (c) 2026 The ZMK Contributors
# SPDX-License-Identifier: MIT

description: Common RGB condition dependencies

properties:
  conditions:
    type: phandles
    description: |
      All conditions whose cached values this provider may read, including
      short-circuited operands. Omit for providers that read no other conditions.
      Targets must be enabled condition providers and the dependency graph must
      be acyclic. Dependencies are sampled before their consumers; independent
      providers have no sampling-order guarantee.
```
