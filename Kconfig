## dts/bindings/keypaw,rgb-condition-effect-selected.yaml
```yaml
# Copyright (c) 2026 The ZMK Contributors
# SPDX-License-Identifier: MIT

description: |
  Active while a selector's retained selection is the specified effect. Returns
  false until the selector's post-restoration startup succeeds. Power, inhibition,
  visibility and local LED count do not affect the comparison.

  This is a local source available on either split half. A default overlay uses
  the central's gate; a local overlay evaluates the local selector's selection.

  Keep this condition outside the selector it references. Do not use it, directly
  or through a composite condition, as that selector's own gate: parent and
  phandle dependencies would form a devicetree cycle. Forward references and
  sharing the condition between sibling overlays are supported.

compatible: "keypaw,rgb-condition-effect-selected"
include: keypaw,rgb-condition-common.yaml

properties:
  selector:
    type: phandle
    required: true
    description: Enabled controllable keypaw,rgb-overlay to query.

  effect:
    type: phandle
    required: true
    description: Enabled effect child of this selector to compare with selection.
```

## dts/bindings/keypaw,rgb-condition-endpoint.yaml
```yaml
# Copyright (c) 2026 The ZMK Contributors
# SPDX-License-Identifier: MIT

description: |
  Central-only host transport condition. Shared nodes compile on peripherals,
  where host capabilities are not required and the condition is false.
  BLE tests require ZMK_BLE on the host side. USB tests require USB_DEVICE_STACK;
  USB connected additionally requires ZMK_USB.

  Routed USB connected follows the selected endpoint. Routed BLE tests are
  suppressed by OUT_NONE, or by USB preference while USB is HID-ready. Thus BLE
  open/disconnected can match while USB is selected as a fallback under OUT_BLE.
  The any transport tests selected-endpoint availability, not physical links;
  under OUT_NONE its connected test is false and disconnected test is true.

  Preference is sampled shortly after position presses and releases and during
  transport-triggered reevaluation. Delayed macros, encoders, direct API calls,
  or settings reloads can leave a preference-only change stale until another
  key or transport event. Sampling is best-effort, not behavior-completion
  ordering; there is no periodic idle polling.

compatible: "keypaw,rgb-condition-endpoint"
include: keypaw,rgb-condition-common.yaml

properties:
  transport:
    type: string
    default: "ble"
    enum: ["ble", "usb", "any"]
    description: Host transport to test.

  state:
    type: string
    default: "connected"
    enum: ["any", "connected", "disconnected", "open", "powered"]
    description: |
      BLE connected tests the active profile link; disconnected negates it;
      open tests for an unbonded profile; any ignores its link state.
      USB connected tests HID readiness subject to routing; disconnected tests
      absent VBUS; powered tests VBUS without HID enumeration. These last two
      USB states are physical tests independent of routing, including OUT_NONE.
      The any transport supports only connected and disconnected.

  profile:
    type: int
    default: -1
    description: |
      Active BLE profile index (0-based), or -1 for any profile. Values below
      -1 are invalid. Indices beyond the configured profile count never match.
      Other transports require -1.

  ignore-routing:
    type: boolean
    description: |
      Test physical state regardless of output preference, including OUT_NONE.
      Defaults to false. Valid only for BLE or USB connected.
```

## dts/bindings/keypaw,rgb-condition-latch.yaml
```yaml
# Copyright (c) 2026 The ZMK Contributors
# SPDX-License-Identifier: MIT

description: |
  Manually toggled condition: active while its stored bool is set.

  This is the one stateful condition kind. The bool lives in the driver's
  dev->data and is flipped by a single keypaw,behavior-rgb-overlay-toggle child
  of this node. The child reaches its parent with DT_PARENT; this node declares
  no phandle to the child, which would be a devicetree cycle.

  The state is volatile and per-half: it is never persisted, and both halves
  start off after a reboot. Use it as an overlay's `condition` (directly, or
  with `local;` so each half gates on its own latch).

compatible: "keypaw,rgb-condition-latch"
```

## dts/bindings/keypaw,rgb-condition-layer.yaml
```yaml
# Copyright (c) 2026 The ZMK Contributors
# SPDX-License-Identifier: MIT

description: |
  Keymap-layer condition: active while a given layer is active.

  Layer state exists only where the keymap does, which on a split is the central
  half. A condition used by a default (central-evaluated) overlay is therefore
  evaluated on the central and pushed as a bit; the condition still compiles and
  links on a peripheral and returns false there, so a shared devicetree expands
  on both halves (a `local` overlay would call it there).

compatible: "keypaw,rgb-condition-layer"

properties:
  layer:
    type: int
    required: true
    description: |
      Layer id this condition watches.

  only-topmost:
    type: boolean
    description: |
      Active only while this is the highest active layer. By default the
      condition follows "this layer is active", which is what a momentary layer
      key wants.
```

## dts/bindings/keypaw,rgb-condition-or.yaml
```yaml
# Copyright (c) 2026 The ZMK Contributors
# SPDX-License-Identifier: MIT

description: |
  Logical OR over other conditions: active while any referenced condition is
  active. `conditions` lists the operands; a combinator may itself reference
  other combinators, but the reference graph must be acyclic.
  Operands are declared dependencies with cached values; short-circuiting does
  not suspend their notifications or deadlines. A local peripheral consumer may
  not reference a central-only source, including through nested combinators.

compatible: "keypaw,rgb-condition-or"

properties:
  conditions:
    type: phandles
    required: true
    description: |
      Conditions to combine, at least one of which must be active. A devicetree
      array cannot be empty, and an empty list is rejected at build time.
```

## dts/bindings/keypaw,rgb-conditions.yaml
```yaml
# Copyright (c) 2026 The ZMK Contributors
# SPDX-License-Identifier: MIT

description: |
  Container for RGB matrix condition nodes. A condition is a reusable predicate
  consumed by overlays (`condition = <&...>`) and by triggers, so one definition
  -- a keymap layer, Caps Lock, an always-on predicate -- serves every consumer
  instead of each reimplementing it.

  The node itself is not a device and has no driver; it groups conditions for
  readability. Conditions have no persisted or split identity. Providers may
  keep volatile state and must notify after coherent source changes. Conditions
  are sampled initially and again on explicit source/dependency invalidation or
  engine refreshes; there is no timed polling. Consumers read cached snapshots. A
  central-evaluated overlay pushes only its resulting on/off bit; a local overlay
  evaluates a tree whose sources must support that half.

compatible: "keypaw,rgb-conditions"
```

## dts/bindings/keypaw,rgb-indicator-caps-lock.yaml
```yaml
# Copyright (c) 2026 The ZMK Contributors
# SPDX-License-Identifier: MIT

description: |
  Caps Lock indicator: paints the targeted LEDs while the host reports the HID
  Caps Lock LED as set (see CONFIG_ZMK_HID_INDICATORS). Has no properties of its
  own beyond the shared indicator fragment.

compatible: "keypaw,rgb-indicator-caps-lock"

include: ["keypaw,rgb-indicator-common.yaml"]
```

## dts/bindings/keypaw,rgb-indicator-layer.yaml
```yaml
# Copyright (c) 2026 The ZMK Contributors
# SPDX-License-Identifier: MIT

description: |
  Keymap layer indicator: paints the targeted LEDs while a given layer is active.
  Declare one node per layer that should have its own LED.

compatible: "keypaw,rgb-indicator-layer"

include: ["keypaw,rgb-indicator-common.yaml"]

properties:
  layer:
    type: int
    required: true
    description: Layer id this indicator watches.

  only-topmost:
    type: boolean
    description: |
      Paint only while this is the highest active layer. By default the indicator
      follows "this layer is active", which is what a momentary layer key wants.
```

## dts/bindings/keypaw,rgb-indicators.yaml
```yaml
# Copyright (c) 2026 The ZMK Contributors
# SPDX-License-Identifier: MIT

description: |
  Container for RGB matrix indicator nodes. Its children are enumerated in
  declaration order and each child's index among them (DT_NODE_CHILD_IDX) is the
  ordinal used to address that indicator's on/off bit on the split link. Both
  halves build the same DTS, so the ordinals agree.

  The node itself is not a device and has no driver; it exists so the engine can
  enumerate every indicator once, across all kinds, in a stable order. Declare
  it once, outside &kprgb, and add the indicator nodes as its children.

compatible: "keypaw,rgb-indicators"
```

## dts/bindings/keypaw,rgb-matrix-band.yaml
```yaml
# Copyright (c) 2026 The ZMK Contributors
# SPDX-License-Identifier: MIT

description: |
  Single-hue board with a moving band that fades either saturation or brightness,
  covering QMK's BAND_SAT / BAND_VAL and their pinwheel / spiral variants
  (BAND_PINWHEEL_SAT/VAL, BAND_SPIRAL_SAT/VAL).
compatible: "keypaw,rgb-matrix-band"
include: [zero_param.yaml, "keypaw,rgb-matrix-effect-common.yaml"]

properties:
  channel:
    type: string
    required: false
    default: "sat"
    enum: ["sat", "val"]
    description: |
      Which channel the band modulates. "sat" fades saturation (BAND_SAT and
      friends); "val" fades brightness (BAND_VAL and friends).

  shape:
    type: string
    required: false
    default: "linear"
    enum: ["linear", "pinwheel", "spiral"]
    description: |
      The path the band travels: "linear" scrolls left to right, "pinwheel" spins
      around the board centre, "spiral" winds outward.
```

## dts/bindings/keypaw,rgb-matrix-breathe.yaml
```yaml
# Copyright (c) 2026 The ZMK Contributors
# SPDX-License-Identifier: MIT

description: Brightness breathing RGB matrix effect (BREATHING), extended with
  position-offset "river" flow (RIVERFLOW) and hue variants (HUE_BREATHING,
  HUE_PENDULUM, HUE_WAVE).
compatible: "keypaw,rgb-matrix-breathe"
include: [zero_param.yaml, "keypaw,rgb-matrix-effect-common.yaml"]

properties:
  mode:
    type: string
    required: false
    default: "brightness"
    enum: ["brightness", "river", "hue", "pendulum", "wave"]
    description: |
      "brightness" (default) fades the whole board up and down (BREATHING).
      "river" offsets the fade by each LED's x position so the pulse travels
      across the board (RIVERFLOW). "hue" oscillates a hue offset while
      brightness stays put (HUE_BREATHING). "pendulum" moves that offset across
      x and reverses direction (HUE_PENDULUM). "wave" rolls the offset
      continuously in the opposite direction (HUE_WAVE).

  hue-amplitude:
    type: int
    required: false
    default: 45
    description: |
      How far the hue swings, in degrees, for the hue-oscillating modes ("hue",
      "pendulum" and "wave"). Ignored by "brightness" and "river".

      The offset runs from 0 up to this value and back once per period, so the
      hue sweeps from the preset colour to preset + amplitude. The hue wheel is
      360 degrees wide; larger values are clamped to it. The default is an
      eighth of the wheel, which reads clearly as movement without turning into
      a rainbow sweep. Values below ~15 are hard to notice at all.
```

## dts/bindings/keypaw,rgb-matrix-digital-rain.yaml
```yaml
# Copyright (c) 2026 The ZMK Contributors
# SPDX-License-Identifier: MIT

description: |
  Matrix-style falling columns: each LED is binned into a column by its layout x,
  and a head falls down each column leaving a fading green (or preset-hue) tail.
  Ported from QMK's DIGITAL_RAIN.

  `color` and `duration` are inherited from the common effect binding. Set `color`
  on the node for a non-green hue; `duration` is the fall speed, as the time a
  drop takes to cross the board (each column is jittered between duration / 3 and
  duration, so shorter is faster). Defaults are applied in the effect's C define.
compatible: "keypaw,rgb-matrix-digital-rain"
include: [zero_param.yaml, "keypaw,rgb-matrix-effect-common.yaml"]
```

## dts/bindings/keypaw,rgb-matrix-effect-common.yaml
```yaml
# Copyright (c) 2026 The ZMK Contributors
# SPDX-License-Identifier: MIT

include: [base.yaml]
properties:
  color:
    type: int
    required: false
    default: 0xFFFFFF
    description: 24-bit RGB preset colour.

  duration:
    type: int
    required: false
    default: 0
    description: |
      Animation period in milliseconds; shorter means faster. Zero uses the
      common 1000 ms fallback. The resulting default is clamped to the configured
      duration bounds before the effect device is initialized.
```

## dts/bindings/keypaw,rgb-matrix-heatmap.yaml
```yaml
# Copyright (c) 2026 The ZMK Contributors
# SPDX-License-Identifier: MIT

description: |
  Per-key heat map of recent keypresses, decaying over time. Port of QMK's
  TYPING_HEATMAP.
compatible: "keypaw,rgb-matrix-heatmap"
include: [zero_param.yaml, "keypaw,rgb-matrix-effect-common.yaml"]

properties:
  decrease-delay-ms:
    type: int
    required: false
    default: 25
    description: |
      How many milliseconds of inactivity before one "shade" of heat is lost.
      Must be nonnegative and fit the effect's unsigned storage.

  spread:
    type: int
    required: false
    default: 150
    description: |
      Nonnegative layout-unit radius over which a press heats neighbouring keys.

  area-limit:
    type: int
    required: false
    default: 16
    description: |
      Nonnegative cap on the heat a neighbouring key receives from a single
      press.

  increase-step:
    type: int
    required: false
    default: 32
    description: |
      Nonnegative shades of heat added per keypress (lower = more keystrokes to
      reach full).

  slim:
    type: boolean
    required: false
    description: |
      Only heat the pressed key itself, not its neighbours.
```
