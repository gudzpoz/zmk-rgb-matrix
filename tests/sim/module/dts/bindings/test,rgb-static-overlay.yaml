## tests/sim/module/dts/bindings/test,rgb-static-overlay.yaml
```yaml
# SPDX-License-Identifier: MIT
description: Static metadata native overlay provider
compatible: "test,rgb-static-overlay"
include: [base.yaml, "keypaw,rgb-overlay-common.yaml"]
properties:
  condition:
    type: phandle
  zero-local-leds:
    type: boolean
```

## tests/sim/module/dts/bindings/test,rgb-token-selector.yaml
```yaml
# Copyright (c) 2026 The ZMK Contributors
# SPDX-License-Identifier: MIT

description: RGB selector with a unit address for persistence-token tests
compatible: "test,rgb-token-selector"
include: "keypaw,rgb-overlay-selector.yaml"
properties:
  reg:
    type: array
```

## tests/sim/module/dts/bindings/test,rgb-token-solid.yaml
```yaml
# Copyright (c) 2026 The ZMK Contributors
# SPDX-License-Identifier: MIT

description: Solid effect with a unit address for persistence-token tests
compatible: "test,rgb-token-solid"
include: "keypaw,rgb-matrix-solid.yaml"
properties:
  reg:
    type: array
```
