## tests/sim/module/dts/bindings/keypaw,led-strip-capture.yaml
```yaml
# Copyright (c) 2026 The ZMK Contributors
# SPDX-License-Identifier: MIT

description: |
  Preview-harness LED strip. A led_strip API device that appends every frame the
  RGB matrix engine hands it to a capture file instead of driving hardware.

  Sim only: this is never part of real firmware. The engine reaches it through
  the ordinary `strip` phandle on keypaw,rgb-matrix, so nothing in the module
  needs to know it exists.

compatible: "keypaw,led-strip-capture"

include: [led-strip.yaml]
```

## tests/sim/module/dts/bindings/keypaw,led-strip-composite-probe.yaml
```yaml
# Copyright (c) 2026 The ZMK Contributors
# SPDX-License-Identifier: MIT

description: RGB output probe for the composite engine integration test

compatible: "keypaw,led-strip-composite-probe"

include: base.yaml

properties:
  chain-length:
    type: int
    required: true
```

## tests/sim/module/dts/bindings/keypaw,native-engine-condition.yaml
```yaml
# Copyright (c) 2026 The ZMK Contributors
# SPDX-License-Identifier: MIT
description: Semaphore-controlled source for native refresh-generation contracts.
compatible: "keypaw,native-engine-condition"
include: keypaw,rgb-condition-common.yaml
```

## tests/sim/module/dts/bindings/keypaw,native-engine-effect.yaml
```yaml
# Copyright (c) 2026 The ZMK Contributors
# SPDX-License-Identifier: MIT
description: Scripted private child for native generic-overlay composition contracts.
compatible: "keypaw,native-engine-effect"
include: keypaw,rgb-matrix-effect-common.yaml
properties:
  slot:
    type: int
    required: true
```

## tests/sim/module/dts/bindings/keypaw,native-engine-overlay.yaml
```yaml
# Copyright (c) 2026 The ZMK Contributors
# SPDX-License-Identifier: MIT
description: Scripted native overlay for lifecycle, composition and scheduling contracts.
compatible: "keypaw,native-engine-overlay"
include: [base.yaml, "keypaw,rgb-overlay-common.yaml", behavior-metadata.yaml]
properties:
  condition:
    type: phandle
  slot:
    type: int
    required: true
  filter:
    type: boolean
  test-behavior:
    type: boolean
  "#binding-cells":
    type: int
```

## tests/sim/module/dts/bindings/keypaw,native-engine-strip.yaml
```yaml
# Copyright (c) 2026 The ZMK Contributors
# SPDX-License-Identifier: MIT
description: Programmable native strip with transfer capture and error injection.
compatible: "keypaw,native-engine-strip"
include: led-strip.yaml
```

## tests/sim/module/dts/bindings/keypaw,rgb-matrix-selector-probe.yaml
```yaml
# Copyright (c) 2026 The ZMK Contributors
# SPDX-License-Identifier: MIT
description: Private selector callback probe for native runtime tests
compatible: "keypaw,rgb-matrix-selector-probe"
include: "keypaw,rgb-matrix-effect-common.yaml"
properties:
  animate:
    type: boolean
```

## tests/sim/module/dts/bindings/keypaw,rgb-overlay-pair.yaml
```yaml
# Copyright (c) 2026 The ZMK Contributors
# SPDX-License-Identifier: MIT

description: Native-sim two-child RGB overlay fixture

compatible: "keypaw,rgb-overlay-pair"

include: ["keypaw,rgb-overlay-common.yaml"]

properties:
  condition:
    type: phandle
    required: false
```

## tests/sim/module/dts/bindings/test,rgb-condition-contract-action.yaml
```yaml
# SPDX-License-Identifier: MIT
description: Native condition-contract one-shot action recorder
compatible: "test,rgb-condition-contract-action"
include: two_param.yaml
```

## tests/sim/module/dts/bindings/test,rgb-condition-contract-control.yaml
```yaml
# SPDX-License-Identifier: MIT
description: Deferred real RGB selector control for startup contracts
compatible: "test,rgb-condition-contract-control"
include: keypaw,behavior-rgb-selector.yaml
properties:
  zephyr,deferred-init:
    type: boolean
```

## tests/sim/module/dts/bindings/test,rgb-condition-contract-strip.yaml
```yaml
# SPDX-License-Identifier: MIT
description: Native condition refresh submission observer
compatible: "test,rgb-condition-contract-strip"
include: led-strip.yaml
```

## tests/sim/module/dts/bindings/test,rgb-condition-contract.yaml
```yaml
# SPDX-License-Identifier: MIT
description: Native condition-contract scripted provider
compatible: "test,rgb-condition-contract"
include: keypaw,rgb-condition-common.yaml
properties:
  central-only:
    type: boolean
  unready:
    type: boolean
  unregistered:
    type: boolean
  invalid-scope:
    type: boolean
  selected-selector:
    type: phandle
  selected-effect:
    type: phandle
```

## tests/sim/module/dts/bindings/test,rgb-control-enum.yaml
```yaml
# Copyright (c) 2026 The ZMK Contributors
# SPDX-License-Identifier: MIT
description: Second provider namespace for native enum helper contracts.
compatible: "test,rgb-control-enum"
include: base.yaml
properties:
  mode:
    type: string
    required: true
    enum: ["sweep", "idle", "pulse"]
```

## tests/sim/module/dts/bindings/test,rgb-control-late.yaml
```yaml
description: Deferred canonical control for native control contracts
compatible: "test,rgb-control-late"
include: "keypaw,behavior-rgb-selector.yaml"
properties:
  zephyr,deferred-init:
    type: boolean
```

## tests/sim/module/dts/bindings/test,rgb-control-probe.yaml
```yaml
description: Native control contract effect
compatible: "test,rgb-control-probe"
include: "keypaw,rgb-matrix-effect-common.yaml"
properties:
  axis:
    type: string
    default: "none"
    enum: ["none", "vertical", "horizontal"]
  mode:
    type: string
    default: "pulse"
    enum: ["idle", "pulse", "sweep"]
  zephyr,deferred-init:
    type: boolean
```

## tests/sim/module/dts/bindings/test,rgb-effects-enum-first.yaml
```yaml
description: Native first effect enum namespace fixture
compatible: "test,rgb-effects-enum-first"
properties:
  mode:
    type: string
    required: true
    enum: [idle, pulse, sweep]
```

## tests/sim/module/dts/bindings/test,rgb-effects-enum-second.yaml
```yaml
description: Native second effect enum namespace fixture
compatible: "test,rgb-effects-enum-second"
properties:
  mode:
    type: string
    required: true
    enum: [sweep, idle, pulse]
```

## tests/sim/module/dts/bindings/test,rgb-effects-probe.yaml
```yaml
description: Native effect-dispatch observation device
compatible: "test,rgb-effects-probe"
include: "keypaw,rgb-matrix-effect-common.yaml"
properties:
  optional-callbacks:
    type: boolean
    description: Omit all callbacks except render.
```

## tests/sim/module/dts/bindings/test,rgb-global-late-control.yaml
```yaml
# Copyright (c) 2026 The ZMK Contributors
# SPDX-License-Identifier: MIT
description: Deferred real global behavior for native endpoint-readiness contracts.
compatible: "test,rgb-global-late-control"
include: "keypaw,behavior-rgb-matrix.yaml"
properties:
  zephyr,deferred-init:
    type: boolean
```

## tests/sim/module/dts/bindings/test,rgb-selector-event-condition.yaml
```yaml
# Copyright (c) 2026 The ZMK Contributors
# SPDX-License-Identifier: MIT
description: Test condition invalidated by selector selection events
compatible: "test,rgb-selector-event-condition"
include: base.yaml
properties:
  selector:
    type: phandle
    required: true
  effect:
    type: phandle
    required: true
```

## tests/sim/module/dts/bindings/test,rgb-selector-late-control.yaml
```yaml
# Copyright (c) 2026 The ZMK Contributors
# SPDX-License-Identifier: MIT

description: Native selector control with deferred device initialization
compatible: "test,rgb-selector-late-control"
include: "keypaw,behavior-rgb-selector.yaml"

properties:
  zephyr,deferred-init:
    type: boolean
```

## tests/sim/module/dts/bindings/test,rgb-settings-late-effect.yaml
```yaml
description: Deferred real solid effect for settings readiness regressions
compatible: "test,rgb-settings-late-effect"
include: keypaw,rgb-matrix-solid.yaml
properties:
  zephyr,deferred-init:
    type: boolean
```

## tests/sim/module/dts/bindings/test,rgb-split-late-global.yaml
```yaml
# Copyright (c) 2026 The ZMK Contributors
# SPDX-License-Identifier: MIT

description: Deferred real global RGB control for split endpoint readiness
compatible: "test,rgb-split-late-global"
include: "keypaw,rgb-matrix.yaml"
properties:
  zephyr,deferred-init:
    type: boolean
```

## tests/sim/module/dts/bindings/test,rgb-static-condition-a.yaml
```yaml
# SPDX-License-Identifier: MIT
description: First translation unit static condition
compatible: "test,rgb-static-condition-a"
include: keypaw,rgb-condition-common.yaml
```

## tests/sim/module/dts/bindings/test,rgb-static-condition-b.yaml
```yaml
# SPDX-License-Identifier: MIT
description: Second translation unit static condition
compatible: "test,rgb-static-condition-b"
include: keypaw,rgb-condition-common.yaml
```
