## CMakeLists.txt
```
# Copyright (c) 2026 The ZMK Contributors
# SPDX-License-Identifier: MIT
#
# Host unit tests for the module's pure helpers (colour math). Built for
# native_sim: rgb_color.h exposes Zephyr's `struct led_rgb`, so the minimal
# `unit_testing` board (which has no syscall/devicetree headers) cannot compile
# it. ztest supplies main(); only rgb_color.c is linked, so the ZMK app is not
# involved.

cmake_minimum_required(VERSION 3.20.0)
find_package(Zephyr REQUIRED HINTS $ENV{ZEPHYR_BASE})
project(keypaw_rgb_unit)

target_sources(app PRIVATE
    src/main.c
    ${CMAKE_CURRENT_SOURCE_DIR}/../../src/rgb_color.c
    ${CMAKE_CURRENT_SOURCE_DIR}/../../src/rgb_persist.c)

target_include_directories(app PRIVATE
    ${CMAKE_CURRENT_SOURCE_DIR}/../../include)
```

## prj.conf
```kconfig
# Copyright (c) 2026 The ZMK Contributors
# SPDX-License-Identifier: MIT

CONFIG_ZTEST=y
CONFIG_UBSAN=y
```

## src/main.c
```c
/*
 * Copyright (c) 2026 The ZMK Contributors
 *
 * SPDX-License-Identifier: MIT
 *
 * Host unit tests for the pure colour and math helpers. No ZMK app, no
 * devicetree: these translate units only.
 */

#include <zephyr/ztest.h>
#include <zephyr/sys/util.h>

#include <zmk/rgb_color.h>
#include <zmk/rgb_matrix_math.h>
#include "../../../src/effects/effect_math.h"

static void assert_rgb(struct led_rgb got, uint8_t r, uint8_t g, uint8_t b) {
  zassert_equal(got.r, r, "r: got %u want %u", got.r, r);
  zassert_equal(got.g, g, "g: got %u want %u", got.g, g);
  zassert_equal(got.b, b, "b: got %u want %u", got.b, b);
}

ZTEST(kp_rgb_color, hsb_to_rgb_primaries) {
  assert_rgb(kp_rgb_hsb_to_rgb((struct kp_rgb_hsb){.h = 0, .s = 100, .b = 100}),
             255, 0, 0);
  assert_rgb(
      kp_rgb_hsb_to_rgb((struct kp_rgb_hsb){.h = 60, .s = 100, .b = 100}), 255,
      255, 0);
  assert_rgb(
      kp_rgb_hsb_to_rgb((struct kp_rgb_hsb){.h = 120, .s = 100, .b = 100}), 0,
      255, 0);
  assert_rgb(
      kp_rgb_hsb_to_rgb((struct kp_rgb_hsb){.h = 180, .s = 100, .b = 100}), 0,
      255, 255);
  assert_rgb(
      kp_rgb_hsb_to_rgb((struct kp_rgb_hsb){.h = 240, .s = 100, .b = 100}), 0, 0,
      255);
  assert_rgb(
      kp_rgb_hsb_to_rgb((struct kp_rgb_hsb){.h = 300, .s = 100, .b = 100}), 255,
      0, 255);
}

ZTEST(kp_rgb_color, hsb_to_rgb_edges) {
  /* Hue wraps: 360 is 0, and an out-of-range hue is reduced too. */
  assert_rgb(
      kp_rgb_hsb_to_rgb((struct kp_rgb_hsb){.h = 360, .s = 100, .b = 100}), 255,
      0, 0);
  assert_rgb(
      kp_rgb_hsb_to_rgb((struct kp_rgb_hsb){.h = 720, .s = 100, .b = 100}), 255,
      0, 0);
  /* Zero saturation is white at full value; zero brightness is black. */
  assert_rgb(kp_rgb_hsb_to_rgb((struct kp_rgb_hsb){.h = 0, .s = 0, .b = 100}),
             255, 255, 255);
  assert_rgb(kp_rgb_hsb_to_rgb((struct kp_rgb_hsb){.h = 0, .s = 100, .b = 0}), 0,
             0, 0);
  /* Off-primary hue: integer rounding is pinned. */
  assert_rgb(
      kp_rgb_hsb_to_rgb((struct kp_rgb_hsb){.h = 0, .s = 50, .b = 100}), 255,
      128, 128);
  assert_rgb(
      kp_rgb_hsb_to_rgb((struct kp_rgb_hsb){.h = 210, .s = 100, .b = 100}), 0,
      128, 255);
}

ZTEST(kp_rgb_color, rgb_scale_clamps) {
  struct led_rgb c = {.r = 200, .g = 100, .b = 50};

  assert_rgb(kp_rgb_rgb_scale(c, 50), 100, 50, 25);
  assert_rgb(kp_rgb_rgb_scale((struct led_rgb){.r = 255, .g = 255, .b = 255}, 50),
             127, 127, 127);
  assert_rgb(kp_rgb_rgb_scale((struct led_rgb){.r = 1, .g = 2, .b = 3}, 50), 0,
             1, 1);

  assert_rgb(kp_rgb_rgb_scale(c, 0), 0, 0, 0);
  assert_rgb(kp_rgb_rgb_scale(c, 100), 200, 100, 50);
  /* Above 100 clamps rather than brightening past the input. */
  assert_rgb(kp_rgb_rgb_scale(c, 150), 200, 100, 50);
}

ZTEST(kp_rgb_color, rgb_mix_endpoints_and_truncation) {
  struct led_rgb black = {0, 0, 0};
  struct led_rgb white = {255, 255, 255};

  assert_rgb(kp_rgb_rgb_mix(black, white, 0), 0, 0, 0);
  assert_rgb(kp_rgb_rgb_mix(black, white, 100), 255, 255, 255);
  assert_rgb(kp_rgb_rgb_mix(black, white, 150), 255, 255, 255);

  /* The blend is asymmetric: (over - base) truncates toward zero, so a 50%
   * mix up from black lands on 127 while the reverse lands on 128. */
  assert_rgb(kp_rgb_rgb_mix(black, white, 50), 127, 127, 127);
  assert_rgb(kp_rgb_rgb_mix(white, black, 50), 128, 128, 128);

  assert_rgb(kp_rgb_rgb_mix((struct led_rgb){1, 1, 1},
                            (struct led_rgb){2, 2, 2}, 50),
             1, 1, 1);
  assert_rgb(kp_rgb_rgb_mix((struct led_rgb){10, 10, 10}, black, 50), 5, 5, 5);
}

ZTEST(kp_rgb_math, isqrt) {
  zassert_equal(kp_rgb_isqrt(0), 0);
  zassert_equal(kp_rgb_isqrt(1), 1);
  zassert_equal(kp_rgb_isqrt(2), 1);
  zassert_equal(kp_rgb_isqrt(4), 2);
  zassert_equal(kp_rgb_isqrt(9), 3);
  zassert_equal(kp_rgb_isqrt(16), 4);
  zassert_equal(kp_rgb_isqrt(255), 15);
  zassert_equal(kp_rgb_isqrt(256), 16);
  zassert_equal(kp_rgb_isqrt(1000), 31);
  zassert_equal(kp_rgb_isqrt(1000000), 1000);
  zassert_equal(kp_rgb_isqrt(UINT32_MAX), 65535);
}

ZTEST(kp_rgb_math, sin8_core) {
  zassert_equal(kp_rgb_sin8(0), 128);
  zassert_equal(kp_rgb_sin8(64), 255);
  zassert_equal(kp_rgb_sin8(128), 128);
  zassert_equal(kp_rgb_sin8(192), 0);
}

ZTEST(kp_rgb_math, atan2_8_cardinals) {
  zassert_equal(kp_rgb_atan2_8(0, 1), 0);
  zassert_equal(kp_rgb_atan2_8(0, -1), 128);
  zassert_equal(kp_rgb_atan2_8(1, 0), 64);
  zassert_equal(kp_rgb_atan2_8(-1, 0), 192);
  zassert_equal(kp_rgb_atan2_8(1, 1), 32);
  zassert_equal(kp_rgb_atan2_8(1, -1), 96);
  zassert_equal(kp_rgb_atan2_8(-1, 1), 224);
  zassert_equal(kp_rgb_atan2_8(-5, -5), 160);
  zassert_equal(kp_rgb_atan2_8(5, -5), 96);
}

ZTEST(kp_rgb_math, atan2_8_coordinate_boundaries) {
  zassert_equal(kp_rgb_atan2_8(0, 0), 0);
  zassert_equal(kp_rgb_atan2_8(0, 65535), 0);
  zassert_equal(kp_rgb_atan2_8(65535, 0), 64);
  zassert_equal(kp_rgb_atan2_8(0, -65535), 128);
  zassert_equal(kp_rgb_atan2_8(-65535, 0), 192);
  zassert_equal(kp_rgb_atan2_8(65535, 65535), 32);
  zassert_equal(kp_rgb_atan2_8(65535, -65535), 96);
  zassert_equal(kp_rgb_atan2_8(-65535, -65535), 160);
  zassert_equal(kp_rgb_atan2_8(-65535, 65535), 224);
  zassert_equal(kp_rgb_atan2_8(32768, 32768), 32);
  zassert_equal(kp_rgb_atan2_8(32768, -32767), 96);
}

ZTEST(kp_rgb_math, effect_distance_exact_floors) {
  uint64_t root_92680_squared = 8589582400ULL;
  zassert_equal(kp_rgb_coord_distance(UINT32_MAX), 65535);
  zassert_equal(kp_rgb_coord_distance((uint64_t)UINT32_MAX + 1), 65536);
  zassert_equal(kp_rgb_coord_distance(root_92680_squared - 1), 92679);
  zassert_equal(kp_rgb_coord_distance(root_92680_squared), 92680);
  zassert_equal(kp_rgb_coord_distance(root_92680_squared + 1), 92680);
  zassert_equal(kp_rgb_coord_distance(2ULL * 65535 * 65535), 92680);
}

ZTEST(kp_rgb_math, effect_squared_coordinate_extremes) {
  zassert_equal(kp_rgb_coord_distance_squared(65535, 0), 4294836225ULL);
  zassert_equal(kp_rgb_coord_distance_squared(-65535, 0), 4294836225ULL);
  zassert_equal(kp_rgb_coord_distance_squared(0, -65535), 4294836225ULL);
  zassert_equal(kp_rgb_coord_distance_squared(65535, -65535),
                2ULL * 65535 * 65535);
  zassert_equal(kp_rgb_coord_distance_squared(-65535, 65535),
                2ULL * 65535 * 65535);
}

ZTEST(kp_rgb_math, effect_spatial_linear_wide_position) {
  zassert_equal(kp_rgb_spatial_linear(98302, 98302), 65536);
}

ZTEST(kp_rgb_math, effect_decay_remainder_and_partitioning) {
  uint16_t remainder = 0;
  zassert_equal(kp_rgb_decay_u8(10, &remainder, 1, 65535), 10);
  zassert_equal(remainder, 1);
  zassert_equal(kp_rgb_decay_u8(10, &remainder, 65534, 65535), 9);
  zassert_equal(remainder, 0);

  uint16_t partitioned_remainder = 0;
  uint8_t partitioned = kp_rgb_decay_u8(200, &partitioned_remainder, 12345, 1000);
  partitioned = kp_rgb_decay_u8(partitioned, &partitioned_remainder, 67890, 1000);
  uint16_t combined_remainder = 0;
  uint8_t combined = kp_rgb_decay_u8(200, &combined_remainder, 80235, 1000);
  zassert_equal(partitioned, combined);
  zassert_equal(partitioned_remainder, combined_remainder);
}

ZTEST(kp_rgb_math, effect_decay_saturation_and_divisor_change) {
  uint16_t remainder = 7;
  zassert_equal(kp_rgb_decay_u8(2, &remainder, 500, 10), 0);
  zassert_equal(remainder, 0);

  remainder = 9;
  zassert_equal(kp_rgb_decay_u8(10, &remainder, 0, 6), 9);
  zassert_equal(remainder, 3);
}

ZTEST(kp_rgb_math, arm_phase) {
  zassert_equal(kp_rgb_arm_phase(100, 1), 100);
  zassert_equal(kp_rgb_arm_phase(100, 2), 50);
  zassert_equal(kp_rgb_arm_phase(100, 3), 33);
  zassert_equal(kp_rgb_arm_phase(100, 0), 100);
  zassert_equal(kp_rgb_arm_phase(100, 4), 25);
}

ZTEST_SUITE(kp_rgb_color, NULL, NULL, NULL, NULL, NULL);
ZTEST_SUITE(kp_rgb_math, NULL, NULL, NULL, NULL, NULL);
```
