## dts/bindings/keypaw,rgb-overlay-selector.yaml
```yaml
# Copyright (c) 2026 The ZMK Contributors
# SPDX-License-Identifier: MIT

description: |
  RGB effect selector. Renders its selected nested effect onto the overlay's
  targets and blends it over earlier output at the configured opacity. Each
  selector owns separate effect devices and retains its selection while hidden,
  OFF or inhibited. Declare at least one enabled effect child; at least one
  child must be ready before RGB control starts. ZMK behavior device names must
  be globally unique and not contain any special characters.

compatible: "keypaw,rgb-overlay-selector"

include: ["keypaw,rgb-overlay-common.yaml"]

properties:
  condition:
    type: phandle
    description: Condition gating the selector's contribution; omit for unconditional output.

  initial-effect:
    type: int
    default: 0
    description: |
      Initial child slot, in declaration order including disabled children.
      Valid range is 0..65535. If this slot is unavailable, the first ready
      enabled child is selected instead.

  initial-duration-ms:
    type: int
    default: 1000
    description: |
      Default period in milliseconds for children whose duration is zero or
      omitted. Clamped to KEYPAW_RGB_MATRIX_DURATION_MIN_MS and
      KEYPAW_RGB_MATRIX_DURATION_MAX_MS. A child's nonzero duration overrides it.
```

## dts/bindings/keypaw,rgb-overlay.yaml
```yaml
# Copyright (c) 2026 The ZMK Contributors
# SPDX-License-Identifier: MIT

description: |
  Composites a nested effect onto its targets over earlier output. A private
  composition owns exactly one enabled effect and is an ordinary device.
  A controllable composition owns one or more enabled effects and is itself a
  GLOBAL behavior. It retains selection while hidden, OFF or inhibited. The
  composition and every enabled child must be initialized before RGB control starts.

compatible: "keypaw,rgb-overlay"
include: ["base.yaml", "keypaw,rgb-overlay-common.yaml", "behavior-metadata.yaml"]

properties:
  controllable:
    type: boolean
    description: |
      Enable selection, color, period and reset commands, selection persistence
      and split repair. Requires an explicit #binding-cells = <2>.
      Private compositions do not participate in these services, even when
      #binding-cells is supplied.

  "#binding-cells":
    type: int
    const: 2

  label:
    type: string
    description: |
      Optional device/behavior endpoint name. Controlled endpoints must be at
      most eight bytes and match on both halves. This does not change the
      node-name identity used for saved selections.

  condition:
    type: phandle
    description: Condition gating contribution; omit for unconditional output.

  initial-effect:
    type: int
    default: 0
    description: |
      Initial controlled child slot in declaration order among enabled children,
      0..65535. An out-of-range slot falls back to slot 0.
      Ignored by private compositions.

binding-cells:
  - param1
  - param2
```

## dts/bindings/keypaw,rgb-overlays.yaml
```yaml
# Copyright (c) 2026 The ZMK Contributors
# SPDX-License-Identifier: MIT

description: |
  Container for RGB matrix overlay nodes. Its children are enumerated in
  declaration order and each child's index among them (DT_NODE_CHILD_IDX) is the
  ordinal used to address that overlay's on/off bit on the split link. Both
  halves build the same DTS, so the ordinals agree.

  The node itself is not a device and has no driver; it exists so the engine can
  enumerate every overlay once, across all kinds, in a stable order. Declare
  it once, outside &kprgb, and add the overlay nodes as its children.

compatible: "keypaw,rgb-overlays"
```

## dts/bindings/keypaw,rgb-trigger-always.yaml
```yaml
# Copyright (c) 2026 The ZMK Contributors
# SPDX-License-Identifier: MIT

description: |
  Unconditional trigger, for use as the final catch-all: list it last so it
  fires whenever no earlier trigger matched. Nothing enforces that ordering --
  placed early it would shadow every trigger after it.

compatible: "keypaw,rgb-trigger-always"

include: ["keypaw,rgb-trigger-common.yaml"]
```

## dts/bindings/keypaw,rgb-trigger-layer.yaml
```yaml
# Copyright (c) 2026 The ZMK Contributors
# SPDX-License-Identifier: MIT

description: |
  Layer trigger: matches while a given keymap layer is active. Because the first
  matching trigger in the keypaw,rgb-trigger-table wins, the declaration order
  of the table's children -- not this node -- is what resolves precedence when
  several layers are held at once.

compatible: "keypaw,rgb-trigger-layer"

include: ["keypaw,rgb-trigger-common.yaml"]

properties:
  layer:
    type: int
    required: true
    description: |
      Layer id this trigger watches. This is a layer id, not an index, matching
      the `layer` property of keypaw,rgb-overlay-layer.
```

## dts/bindings/keypaw,rgb-trigger-table.yaml
```yaml
# Copyright (c) 2026 The ZMK Contributors
# SPDX-License-Identifier: MIT

description: |
  Ordered RGB condition-edge rules. Children execute in declaration order on
  the split central or standalone device, never on a split peripheral.
  Startup actions run after provider readiness, RGB defaults, and settings
  restoration. Conditions are sampled predicates, not lossless event queues.

compatible: "keypaw,rgb-trigger-table"

child-binding:
  description: |
    Independent actions on condition edges. At least one of on-enter and on-exit
    must contain a binding. Each action receives one pressed invocation; no
    matching release is sent. Use only behaviors that complete without a release,
    including third-party one-shot behaviors. The user must ensure this; action
    targets are not restricted to an allowlist. on-exit invokes its own actions,
    not releases for on-enter actions. Global commands use central conversion and
    split transport once. Invalid condition snapshots disable the rule without an
    exit action. Initially true conditions invoke on-enter; initially false
    conditions invoke nothing. All rules use one cached condition pass; action-driven
    source changes take effect in a subsequent queued pass, without rollback of
    earlier actions. Rules must not form feedback loops, and condition samples must
    be side-effect-free and must not synchronously invalidate conditions. Runtime
    feedback detection, pass limits and quarantine are not provided.
  properties:
    condition:
      type: phandle
      description: |
        Cached condition predicate. Absent means constant true, so startup
        invokes on-enter once and on-exit never runs.
    on-enter:
      type: phandle-array
      specifier-space: binding
      description: |
        Commands invoked in order on false-to-true edges. Relative RGB commands
        are converted to absolute values centrally before global dispatch.
    on-exit:
      type: phandle-array
      specifier-space: binding
      description: Commands invoked in order on true-to-false edges.
```

## dts/bindings/keypaw,rgb-trigger.yaml
```yaml
# Copyright (c) 2026 The ZMK Contributors
# SPDX-License-Identifier: MIT

description: |
  One rule in a keypaw,rgb-trigger-table. While its condition is active it is
  the winning trigger, and its `bindings` run when it *becomes* the winner; the
  declaration order of the table's children is the precedence order, so the
  first active rule wins.

  A trigger changes RGB *state* (on/off, cycle, colour, ...) rather than
  compositing a *view* -- use an overlay to show an effect while a condition
  holds. Its condition is a reusable keypaw,rgb-condition-* node, so one
  predicate serves both an overlay and a trigger.

compatible: "keypaw,rgb-trigger"

properties:
  condition:
    type: phandle
    required: false
    description: |
      Predicate that makes this trigger win. Omit it for an always-active rule
      (the table's catch-all), which must be declared last.

  bindings:
    type: phandle-array
    required: true
    description: |
      Commands to invoke, in order, when this trigger becomes the winning one.
      Each element is a full behavior binding, normally targeting &kprgb, e.g.
      `bindings = <&kprgb RGB_EFS_CMD 7>;`. Relative commands (RGB_HUI, RGB_BRI,
      ...) are resolved to absolute values on the central before being sent, so
      both halves converge. Keep the list short: each command is one packet per
      peripheral half.
```

## dts/bindings/led_strip/zmk,led-strip-composite.yaml
```yaml
# Copyright (c) 2026 The ZMK Contributors
# SPDX-License-Identifier: MIT

description: |
  Concatenates RGB LED-strip devices into one logical strip. The first device
  in strips receives the first pixels, followed by each subsequent device.
  Child devices may themselves be composites. Each physical strip must appear
  only once within a composite's complete tree.

  Updates are sequential, not simultaneous. If a child fails, the remaining
  covered children are still updated and the first error is returned. A failed
  call may therefore have changed some physical strips. Submitted pixels may
  be overwritten even when an update fails.

  Short updates cover a prefix of the logical strip and leave later children
  untouched; the final covered child must support the shorter update. An empty
  update succeeds without accessing the buffer. A nonempty update with a NULL
  buffer returns -EINVAL; a count exceeding chain-length returns -ERANGE.
  Raw-channel updates return -ENOSYS.

  Callers must serialize access to shared physical outputs, including access
  through other composites or directly to children. This device provides no
  additional ISR-safety guarantee beyond its children.

  Initialization requires ready child devices with RGB-update and length
  callbacks. Each child's reported length must match its chain-length. By
  default, composites initialize at POST_KERNEL priority 91; consumers must
  initialize later and child devices earlier. Nested composites may share the
  same priority on Zephyr 4.1. Adjust LED_STRIP_COMPOSITE_INIT_PRIORITY when
  children initialize later. Children retain their own color-mapping settings.

compatible: "zmk,led-strip-composite"

include: base.yaml

properties:
  strips:
    type: phandles
    required: true
    description: |
      Nonempty ordered list of enabled RGB LED-strip devices. References must
      be distinct, must not include this device and must not form cycles.

  chain-length:
    type: int
    required: true
    description: |
      Total logical pixel count (1..2147483647). Must equal the sum of the
      child devices' positive chain-length properties.
```

## tests/sim/module/Kconfig
```kconfig
# Copyright (c) 2026 The ZMK Contributors
# SPDX-License-Identifier: MIT

config KEYPAW_SIM_CAPTURE
    bool "native_sim RGB matrix frame capture"
    default y
    depends on ARCH_POSIX
    depends on LED_STRIP
    help
      A led_strip device that records the RGB matrix frames, plus the
      --effect/--capture native simulator command line options. Used by the
      offline preview harness to turn the module's effects into GIFs. Never
      built into real firmware: the module is only added to the build when the
      harness passes it in ZMK_EXTRA_MODULES, and this depends on ARCH_POSIX.

config KEYPAW_SIM_COMPOSITE_TEST
    bool "native_sim composite strip engine integration test"
    default n
    depends on ARCH_POSIX && LED_STRIP

config KEYPAW_SIM_SELECTOR_TEST
    bool "native_sim selector runtime test"
    default n
    depends on ARCH_POSIX && LED_STRIP

config KEYPAW_SIM_SETTINGS_TEST
    bool "native_sim scoped settings integration test"
    default n
    depends on ARCH_POSIX

config KEYPAW_SIM_SPLIT_TEST
    bool "native_sim scoped split transport integration test"
    default n
    depends on ARCH_POSIX && ZMK_SPLIT
    depends on !KEYPAW_SIM_SELECTOR_TEST

config KEYPAW_SIM_SINGLETON_SPLIT_TEST
    bool "Native global-only transport call tracing"
    default n
    depends on KEYPAW_SIM_SPLIT_TEST && ZMK_SPLIT_ROLE_CENTRAL

config KEYPAW_SIM_FIXED_SCENE_TEST
    bool "native_sim fixed overlay scene integration test"
    default n
    depends on ARCH_POSIX && LED_STRIP

config KEYPAW_SIM_CONTRACTS
    bool
    depends on ARCH_POSIX

config KEYPAW_SIM_ENGINE_CONTRACTS
    bool "Native engine contracts"
    depends on ARCH_POSIX && LED_STRIP
    select KEYPAW_SIM_CONTRACTS

config KEYPAW_SIM_CONDITION_CONTRACTS
    bool "Native condition and trigger contracts"
    depends on ARCH_POSIX && LED_STRIP
    select KEYPAW_SIM_CONTRACTS

config KEYPAW_SIM_CONTROL_CONTRACTS
    bool "Native selector and parameter contracts"
    depends on ARCH_POSIX && LED_STRIP
    select KEYPAW_SIM_CONTRACTS

config KEYPAW_SIM_EFFECT_CONTRACTS
    bool "Native effect and owner contracts"
    depends on ARCH_POSIX && LED_STRIP
    select KEYPAW_SIM_CONTRACTS
```
