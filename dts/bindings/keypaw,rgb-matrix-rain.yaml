## dts/bindings/keypaw,rgb-matrix-rain.yaml
```yaml
# Copyright (c) 2026 The ZMK Contributors
# SPDX-License-Identifier: MIT

description: |
  Randomly lit keys with random colours, covering QMK's PIXEL_RAIN, PIXEL_FLOW,
  RAINDROPS, JELLYBEAN_RAINDROPS and PIXEL_FRACTAL via the `mode` attribute.
compatible: "keypaw,rgb-matrix-rain"
include: [zero_param.yaml, "keypaw,rgb-matrix-effect-common.yaml"]

properties:
  mode:
    type: string
    required: false
    default: "pixel"
    enum: ["pixel", "flow", "drops", "jellybean", "fractal"]
    description: |
      "pixel" lights random keys with random hues (PIXEL_RAIN), "jellybean" also
      randomises saturation (JELLYBEAN_RAINDROPS), "flow" runs a cursor along the
      LED chain with random hues (PIXEL_FLOW), "fractal" pulses a single hue
      outward from the board centre (PIXEL_FRACTAL), and "drops" nudges one
      random key's hue each step while the rest of the board stays lit
      (RAINDROPS).

      Unlike every other mode, "drops" never turns an LED off, and it keeps the
      preset's saturation while varying only the hue. It therefore needs a
      saturated `color` to be visible: with a white preset every key renders as
      the same white and the effect looks static.

  step-interval-ms:
    type: int
    default: 32
    description: |
      Interval in milliseconds, from 1 to 65535, between random spawn attempts
      in pixel/jellybean mode or cursor advances in flow mode. Each spawn attempt
      has a 35% chance of lighting one random LED; a spawn is not guaranteed.
      This interval is independent of render cadence. Duration controls fading.
      Ignored by drops (64 hue nudges per duration) and fractal (one phase cycle
      per duration). At most eight due attempts/advances/nudges are processed per
      render; excess opportunities are skipped, but fading and fractal phase
      still consume the full elapsed time.
```

## dts/bindings/keypaw,rgb-matrix-rainbow.yaml
```yaml
# Copyright (c) 2026 The ZMK Contributors
# SPDX-License-Identifier: MIT

description: |
  Generalized gradient-animator effect. One compatible covers QMK's
  CYCLE_LEFT_RIGHT, CYCLE_UP_DOWN, CYCLE_OUT_IN(_DUAL), RAINBOW_MOVING_CHEVRON,
  CYCLE_PINWHEEL, CYCLE_SPIRAL, DUAL_BEACON, RAINBOW_BEACON, RAINBOW_PINWHEELS,
  FLAG and FLOWER_BLOOMING, selected by the basis / direction / palette
  attributes. Instantiate several nodes with different attributes to get several
  distinct cycle entries (e.g. one node per desired animation).

compatible: "keypaw,rgb-matrix-rainbow"
include: [zero_param.yaml, "keypaw,rgb-matrix-effect-common.yaml"]

properties:
  basis:
    type: string
    required: false
    default: "x"
    enum: ["x", "y", "radial", "pinwheel", "spiral", "chevron", "flag"]
    description: |
      The spatial coordinate the colour is mapped onto. "x" is the canonical
      left-right rainbow sweep (CYCLE_LEFT_RIGHT), "y" top-bottom (CYCLE_UP_DOWN),
      radiates from the board centre (CYCLE_OUT_IN / DUAL_BEACON), "pinwheel"
      rotates around it (CYCLE_PINWHEEL / RAINBOW_PINWHEELS), "spiral" windings
      outward (CYCLE_SPIRAL), "chevron" forms a V (RAINBOW_MOVING_CHEVRON), and
      "flag" is a left-right sweep skewed per row so the bands undulate (FLAG).

  direction:
    type: string
    required: false
    default: "out"
    enum: ["out", "in", "dual", "bloom"]
    description: |
      "out" sweeps the pattern outward; "in" reverses it. "dual" uses two
      centres (left/right of the half) for DUAL_BEACON / RAINBOW_PINWHEELS.
      "bloom" mirrors each half (FLOWER_BLOOMING); meaningful with basis "x".

  palette:
    type: string
    required: false
    default: "rainbow"
    enum: ["rainbow", "solid"]
    description: |
      "rainbow" paints the full hue wheel across the board (QMK cycle_*).
      "solid" keeps a single hue and instead shows a travelling brightness band.
```

## dts/bindings/keypaw,rgb-matrix-reactive.yaml
```yaml
# Copyright (c) 2026 The ZMK Contributors
# SPDX-License-Identifier: MIT

description: Reactive keypress-fade RGB matrix effect, extended with spread shapes
  and a gradient palette (SOLID_REACTIVE_* / *_CROSS / *_NEXUS / SPLASH families).
compatible: "keypaw,rgb-matrix-reactive"
include: [zero_param.yaml, "keypaw,rgb-matrix-effect-common.yaml"]

properties:
  background-brightness:
    type: int
    required: false
    default: 10
    description: |
      Brightness (0..100 percent of the effect colour) of an LED whose key is
      not pressed. Effect local: this is not the keyboard-wide idle brightness,
      which lives on the &kprgb node as `idle-brightness`.

  spread:
    type: string
    required: false
    default: "point"
    enum: ["point", "disc", "cross", "nexus"]
    description: |
      Shape around the pressed key that lights up. "point" lights only the key
      (SOLID_REACTIVE_SIMPLE/_REACTIVE). "disc" lights a radius around it
      (SOLID_REACTIVE_WIDE). "cross" lights its row and column
      (SOLID_REACTIVE_CROSS). "nexus" lights everything except the row/column,
      fading with distance (SOLID_REACTIVE_NEXUS).

  spread-radius:
    type: int
    required: false
    default: 250
    description: |
      Falloff radius for "disc" and "nexus", in the same physical-layout units
      as the LEDs (100 = one key width).

  multi:
    type: boolean
    required: false
    description: |
      Accumulate several simultaneous keypresses instead of tracking only the
      most recent one (SOLID_REACTIVE_MULTIWIDE / _MULTICROSS / _MULTINEXUS).

  palette:
    type: string
    required: false
    default: "solid"
    enum: ["solid", "gradient"]
    description: |
      "solid" (default) pulses with the effect's single hue. "gradient" paints
      each lit LED with a position-based hue (SPLASH / MULTISPLASH families).
```

## dts/bindings/keypaw,rgb-matrix-ripple.yaml
```yaml
# Copyright (c) 2026 The ZMK Contributors
# SPDX-License-Identifier: MIT

description: Radial ripple RGB matrix effect.
compatible: "keypaw,rgb-matrix-ripple"
include: [zero_param.yaml, "keypaw,rgb-matrix-effect-common.yaml"]

properties:
  background-brightness:
    type: int
    required: false
    default: 10
    description: |
      Brightness (percent of the effect colour) of the unlit background the
      ripples expand over. Effect local: this is not the keyboard-wide idle
      brightness, which lives on the &kprgb node as `idle-brightness`.
```

## dts/bindings/keypaw,rgb-matrix-solid.yaml
```yaml
# Copyright (c) 2026 The ZMK Contributors
# SPDX-License-Identifier: MIT

description: Static single-colour RGB matrix effect (SOLID_COLOR), extended with a
  static gradient mode (GRADIENT_UP_DOWN / GRADIENT_LEFT_RIGHT).
compatible: "keypaw,rgb-matrix-solid"
include: [zero_param.yaml, "keypaw,rgb-matrix-effect-common.yaml"]

properties:
  axis:
    type: string
    required: false
    default: "none"
    enum: ["none", "vertical", "horizontal"]
    description: |
      "none" (default) is a flat single colour. "vertical" sweeps the hue across
      the board's y axis (GRADIENT_UP_DOWN); "horizontal" sweeps across x
      (GRADIENT_LEFT_RIGHT). The preset hue sets the start of the sweep.
```

## dts/bindings/keypaw,rgb-matrix-spectrum.yaml
```yaml
# Copyright (c) 2026 The ZMK Contributors
# SPDX-License-Identifier: MIT

description: Full-spectrum hue-cycle RGB matrix effect (CYCLE_ALL). Every LED
  shares the same global hue phase.
compatible: "keypaw,rgb-matrix-spectrum"
include: [zero_param.yaml, "keypaw,rgb-matrix-effect-common.yaml"]
```

## dts/bindings/keypaw,rgb-matrix-starlight.yaml
```yaml
# Copyright (c) 2026 The ZMK Contributors
# SPDX-License-Identifier: MIT

description: |
  LEDs turn on and off at random at varying brightness, keeping the user colour
  (with optional hue/sat jitter). Covers QMK's STARLIGHT, STARLIGHT_SMOOTH,
  STARLIGHT_DUAL_HUE and STARLIGHT_DUAL_SAT.
compatible: "keypaw,rgb-matrix-starlight"
include: [zero_param.yaml, "keypaw,rgb-matrix-effect-common.yaml"]

properties:
  step-interval-ms:
    type: int
    default: 32
    description: |
      Interval in milliseconds (1..65535) between independent per-LED trials
      with a 4% probability of changing the target brightness, not guaranteed
      changes. Independent of renderer cadence; duration controls the smooth
      brightness fade. At most eight trials run per render; excess trials are
      skipped without discarding elapsed fade time.

  smooth:
    type: boolean
    required: false
    description: |
      Ramp brightness up and down instead of switching instantly
      (STARLIGHT_SMOOTH).

  dual-hue:
    type: boolean
    required: false
    description: |
      Jitter each lit LED's hue by +/-30 (STARLIGHT_DUAL_HUE).

  dual-sat:
    type: boolean
    required: false
    description: |
      Jitter each lit LED's saturation by +/-30 (STARLIGHT_DUAL_SAT).
```

## dts/bindings/keypaw,rgb-matrix-static.yaml
```yaml
# Copyright (c) 2026 The ZMK Contributors
# SPDX-License-Identifier: MIT

description: |
  Static per-LED colour map: each LED is painted with a colour from the
  `led-colors` array, indexed by LED chain index. A superset of QMK's
  ALPHAS_MODS (just assign different colours to alpha vs modifier keys) and any
  other fixed per-key art.
compatible: "keypaw,rgb-matrix-static"
include: [zero_param.yaml, "keypaw,rgb-matrix-effect-common.yaml"]

properties:
  led-colors:
    type: array
    required: false
    default: [ ]
    description: |
      List of 24-bit RGB values, one per LED, indexed by the LED's position in
      the strip chain (0 = first LED). LEDs beyond the list length are left off.
      The list length must not exceed the number of LEDs.
```

## dts/bindings/keypaw,rgb-matrix-swirl.yaml
```yaml
# Copyright (c) 2026 The ZMK Contributors
# SPDX-License-Identifier: MIT

description: Position-aware hue sweep RGB matrix effect.
compatible: "keypaw,rgb-matrix-swirl"
include: [zero_param.yaml, "keypaw,rgb-matrix-effect-common.yaml"]
```

## dts/bindings/keypaw,rgb-matrix.yaml
```yaml
# Copyright (c) 2026 The ZMK Contributors
# SPDX-License-Identifier: MIT

description: |
  Position-aware RGB LED matrix.

  Every LED carries an (x, y) position in the same units as the
  zmk,physical-layout (keypaw48: 100 = one key width) plus the key position it
  sits under. That is what lets effects use real geometry instead of treating
  the strip as an unnamed line.

  This singleton is also the global two-parameter behavior for power, master
  brightness and reset. Its effective device name must be at most eight
  characters and match on both split halves.

  Direct children are overlays in composition order. Their child indices,
  including disabled children, address gate bits on the split link. Keep the
  same child order on both halves. Conditions, triggers and selector controls
  belong outside this node; effects belong under their overlay owners.

compatible: "keypaw,rgb-matrix"

include: two_param.yaml

properties:

  strip:
    type: phandle
    required: false
    description: |
      The physical or composite LED strip device driving this half's LEDs.
      Omit it when the half has no local LEDs (a USB-dongle central): nothing
      is rendered and "mapping" must then be empty. When present, its
      chain-length is the single source of truth for the LED count and the
      "mapping" length must agree with it.

  physical-layout:
    type: phandle
    required: true
    description: |
      The zmk,physical-layout node whose key attributes are used to place every
      per-key LED. A "mapping" entry that is a plain integer is treated as a key
      position into this layout; the LED's (x, y) centre is computed from the
      key's (x, y, width, height). LEDs not under a key use KP_RGB_NO_KEY(x, y)
      in the "mapping" instead.

  mapping:
    type: array
    required: true
    description: |
      Flat array, one entry per LED, in WS2812 chain order. Each entry is
      either a global key position (0..N-1) whose keycap sits above the LED --
      its centre is derived from "physical-layout" -- or KP_RGB_NO_KEY(x, y)
      for an LED not under a key (an edge/underglow LED) carrying explicit (x,
      y) coordinates in physical-layout units (100 = one key width). Length
      must equal the chain-length of "strip", and is empty when "strip" is
      omitted.

  max-brightness:
    type: int
    default: 40
    description: Capped RGB brightness in percent (0..100).

  idle-brightness:
    type: int
    default: 30
    description: |
      RGB brightness in percent (0..100) to use while the keyboard is idle
      (ZMK activity not ACTIVE). Only observable with
      CONFIG_KEYPAW_RGB_MATRIX_AUTO_OFF_IDLE=n, which keeps the LEDs on instead
      of turning them off when idle.

  initial-brightness:
    type: int
    default: 30
    description: Initial brightness in percent (0..100).

  initial-on:
    type: boolean
    description: Start the matrix enabled; omit to start disabled.
```

## dts/bindings/keypaw,rgb-overlay-battery.yaml
```yaml
# Copyright (c) 2026 The ZMK Contributors
# SPDX-License-Identifier: MIT

description: |
  Battery gauge using this half's state of charge. Bar mode paints a positional
  level bar; hue mode paints every target with a charge-dependent hue.
  Without battery reporting, the charge is treated as zero.

compatible: "keypaw,rgb-overlay-battery"

include: ["keypaw,rgb-overlay-common.yaml"]

properties:
  mode:
    type: string
    default: "bar"
    enum: ["bar", "hue"]
    description: |
      Bar uses color, background-color and reverse; hue ignores those properties.
      Hue uses hue-empty and hue-full; bar ignores those properties.

  hue-empty:
    type: int
    default: 0
    description: |
      Hue at 0% charge, in degrees (0..359). Hue mode interpolates directly
      between the numeric endpoints, not along the shortest path around the
      wheel, at full saturation and brightness before opacity is applied.

  hue-full:
    type: int
    default: 120
    description: Hue at 100% charge, in degrees (0..359).

  condition:
    type: phandle
    required: false
    description: |
      Predicate that gates the gauge; omit for always active. Usually a
      keypaw,rgb-condition-latch so a key can toggle it.

  color:
    type: int
    required: false
    default: 0x00FF00
    description: 24-bit 0xRRGGBB colour of the lit portion of the bar.

  background-color:
    type: int
    required: false
    default: 0x000000
    description: 24-bit 0xRRGGBB colour of the unlit portion of the bar.

  reverse:
    type: boolean
    description: |
      Fill from the opposite end of the derived reading order. The order sorts
      along the target LEDs' longer axis first (left-to-right for a wide half or
      a wide row), then along the other axis.
```

## dts/bindings/keypaw,rgb-overlay-caps-lock.yaml
```yaml
# Copyright (c) 2026 The ZMK Contributors
# SPDX-License-Identifier: MIT

description: |
  Caps Lock overlay: paints the targeted LEDs while the host reports the HID
  Caps Lock LED as set (see CONFIG_ZMK_HID_INDICATORS). Has no properties of its
  own beyond the shared overlay fragment.

compatible: "keypaw,rgb-overlay-caps-lock"

include: ["keypaw,rgb-overlay-common.yaml"]
```

## dts/bindings/keypaw,rgb-overlay-layer.yaml
```yaml
# Copyright (c) 2026 The ZMK Contributors
# SPDX-License-Identifier: MIT

description: |
  Keymap layer overlay: paints the targeted LEDs while a given layer is active.
  Declare one node per layer that should have its own LED.

compatible: "keypaw,rgb-overlay-layer"

include: ["keypaw,rgb-overlay-common.yaml"]

properties:
  layer:
    type: int
    required: true
    description: Layer id this overlay watches.

  only-topmost:
    type: boolean
    description: |
      Paint only while this is the highest active layer. By default the overlay
      follows "this layer is active", which is what a momentary layer key wants.
```
